## src/esp/main/Kconfig
```kconfig
menu "TRS-IO"

choice
    prompt "Target"
    default TRS_IO_MODEL_3
    help
        Select the platform that TRS-IO is targetting...

config TRS_IO_MODEL_1
    bool "TRS-80 Model 1"
config TRS_IO_MODEL_3
    bool "TRS-80 Model III"
config TRS_IO_PP
    bool "TRS-IO++"
endchoice

config TRS_IO_USE_COMPILE_TIME_WIFI_CREDS
    bool "Use compile-time credentials for WiFi"
    default n
    help
        If enabled, TRS-IO will use hard-coded credentials to
        connect to the specified WiFi network. If disabled,
        TRS-IO will create a WiFi Access Point to allow
        provisioning of WiFi credentials at runtime.

config TRS_IO_SSID
    string "WiFi SSID"
    depends on TRS_IO_USE_COMPILE_TIME_WIFI_CREDS
    default ""
    help
        Sets a compile-time SSID that TRS-IO will connect to.

config TRS_IO_PASSWD
    string "WiFi password"
    depends on TRS_IO_USE_COMPILE_TIME_WIFI_CREDS
    default ""
    help
        Set a compile-time password that TRS-IO will use
        to connect to a given WiFi.

config TRS_IO_TEST_LED
    bool "Test LED"
    default n
    help
        If enabled, run LED test (cycle through RGB colors). In that
        mode, TRS-IO will not do anything else besides the test.

endmenu
```
